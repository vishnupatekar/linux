## Documentation/devicetree/bindings/mfd/ac100.txt
```
X-Powers AC100 Codec/RTC IC device tree bindings

AC100 is a audio codec and RTC subsystem combo ICs. The 2 parts are
completely separate, including power supplies and interrupt lines.
The only hardware shared is the host interface to its internal
registers.

Required properties:
- compatible: "x-powers,ac100"
- reg: The I2C slave address or RSB hardware address for the chip
- sub-nodes:
  - codec
    - compatible: "x-powers,ac100-codec"
    - interrupt-parent: The parent interrupt controller
    - interrupts: SoC NMI / GPIO interrupt connected to the IRQ_AUDIO pin
    - unfinished...
  - rtc
    - compatible: "x-powers,ac100-rtc"
    - interrupt-parent: The parent interrupt controller
    - interrupts: SoC NMI / GPIO interrupt connected to the IRQ_RTC pin
    - #clock-cells: shall be 1
    - clock-output-names: "cko1_rtc", "cko2_rtc", "cko3_rtc"
    - see clock/clock-bindings.txt for common clock bindings

Example:

ac100: codec@e89 {
	compatible = "x-powers,ac100";
	reg = <0xe89>;

	codec {
		compatible = "x-powers,ac100-codec";
		interrupt-parent = <&nmi_intc>;
		interrupts = <0 IRQ_TYPE_LEVEL_LOW>;
	};

	rtc {
		compatible = "x-powers,ac100-rtc";
		interrupt-parent = <&nmi_intc>;
		interrupts = <0 IRQ_TYPE_LEVEL_LOW>;
		#clock-cells = <1>;
		clock-output-names = "cko1_rtc", "cko2_rtc", "cko3_rtc";
	};
};
```
